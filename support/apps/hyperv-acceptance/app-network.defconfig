## support/apps/hyperv-acceptance/app-network.defconfig
```kconfig
CONFIG_ARCH_X86_64=y
CONFIG_PLAT_HYPERV=y
CONFIG_UKPLAT_CPU_MAXCOUNT=1
CONFIG_UKPLAT_MEMREGION_MAX_COUNT=512
CONFIG_LIBUKPRINT_KLVL_INFO=y
CONFIG_LIBUKDEBUG_PRINTD=n
CONFIG_APPHYPERVACCEPTANCE=y
CONFIG_APPHYPERVACCEPTANCE_NETWORK_APPLICATION=y
CONFIG_APPHYPERVACCEPTANCE_PEER_IPV4="10.87.0.4"
CONFIG_APPHYPERVACCEPTANCE_PEER_TCP_PORT=18887
CONFIG_APPHYPERVACCEPTANCE_PEER_UDP_PORT=18888
CONFIG_APPHYPERVACCEPTANCE_NONCE="87c0ffee5aa8dfd6"
CONFIG_LIBVMBUS=y
CONFIG_LIBUKBLKDEV=y
CONFIG_LIBSTORVSC=y
CONFIG_LIBSTORVSC_MAX_DEVICES=2
CONFIG_LIBSTORVSC_REQUEST_TIMEOUT_MS=5000
CONFIG_LIBUKSGLIST=y
CONFIG_LIBUKNETDEV=y
CONFIG_LIBUKNETDEV_MAXNBQUEUES=1
CONFIG_LIBNETVSC=y
CONFIG_LIBLWIP=y
CONFIG_LWIP_RELEASE212=y
CONFIG_LWIP_UKNETDEV=y
CONFIG_LWIP_AUTOIFACE=n
CONFIG_LWIP_NOTHREADS=y
CONFIG_LWIP_HEAP=y
CONFIG_LWIP_IPV4=y
CONFIG_LWIP_IPV6=n
CONFIG_LWIP_UDP=y
CONFIG_LWIP_TCP=y
CONFIG_LWIP_TCP_MSS=1460
CONFIG_LWIP_WND_SCALE=n
CONFIG_LWIP_NUM_TCPCON=4
CONFIG_LWIP_NUM_TCPLISTENERS=1
CONFIG_LWIP_ICMP=y
CONFIG_LWIP_DHCP=y
CONFIG_LWIP_DNS=n
CONFIG_LWIP_SOCKET=n
CONFIG_LIBUKRANDOM_LCPU=y
```

## support/apps/hyperv-acceptance/http-service.defconfig
```kconfig
CONFIG_UK_NAME="helloworld"
CONFIG_UK_DEFNAME="helloworld"
CONFIG_ARCH_X86_64=y
CONFIG_PLAT_HYPERV=y
CONFIG_HYPERV_WAIT_MAX_SPINS=50000000
CONFIG_HYPERV_VMBUS=y
CONFIG_HYPERV_NETVSC=y
CONFIG_LIBUKDEBUG=y
CONFIG_LIBUKDEBUG_PRINTK=y
CONFIG_LIBUKDEBUG_PRINTK_INFO=y
CONFIG_LIBUKDEBUG_ENABLE_ASSERT=y
CONFIG_LIBUKBOOT=y
CONFIG_LIBUKBOOT_BANNER_NONE=y
CONFIG_LIBUKBOOT_MAINTHREAD=y
CONFIG_LIBUKBOOT_INITBBUDDY=y
CONFIG_LIBUKBOOT_INITSCHEDCOOP=y
CONFIG_LIBUKALLOC=y
CONFIG_LIBUKALLOC_IFSTATS=y
CONFIG_LIBUKALLOCBBUDDY=y
CONFIG_LIBUKSCHED=y
CONFIG_LIBUKSCHEDCOOP=y
CONFIG_LIBUKMPI=y
CONFIG_LIBUKLOCK=y
CONFIG_LIBUKLOCK_SEMAPHORE=y
CONFIG_LIBUKLOCK_MUTEX=y
CONFIG_LIBUKTIMECONV=y
CONFIG_LIBNOLIBC=y
CONFIG_LIBUKNETDEV=y
CONFIG_LIBUKNETDEV_MAXNBQUEUES=1
CONFIG_LIBUKSGLIST=y
CONFIG_LIBUKRANDOM=y
# CONFIG_LIBUKRANDOM_LCPU is not set
CONFIG_LIBUKRANDOM_SW=y
CONFIG_LIBUKRANDOM_DEVFS=n
CONFIG_LIBUKSTREAMBUF=y
CONFIG_LIBLWIP=y
CONFIG_LWIP_RELEASE212=y
CONFIG_LWIP_UKNETDEV=y
# CONFIG_LWIP_AUTOIFACE is not set
CONFIG_LWIP_UKNETDEV_POLLONLY=y
CONFIG_LWIP_UKNETDEV_SCRATCH=64
CONFIG_LWIP_NOTHREADS=y
CONFIG_LWIP_HEAP=y
CONFIG_LWIP_NETBUF_RECVINFO=y
CONFIG_LWIP_IPV4=y
CONFIG_LWIP_UDP=y
CONFIG_LWIP_TCP=y
CONFIG_LWIP_TCP_MSS=1460
CONFIG_LWIP_WND_SCALE=y
CONFIG_LWIP_TCP_KEEPALIVE=y
CONFIG_LWIP_TCP_TIMESTAMPS=n
CONFIG_LWIP_NUM_TCPCON=64
CONFIG_LWIP_NUM_TCPLISTENERS=4
CONFIG_LWIP_ICMP=y
CONFIG_LWIP_IGMP=n
CONFIG_LWIP_SNMP=n
CONFIG_LWIP_DHCP=y
CONFIG_LWIP_DNS=n
CONFIG_LWIP_SOCKET=n
CONFIG_LWIP_DEBUG=n
CONFIG_APPHYPERVACCEPTANCE=y
CONFIG_APPHYPERVACCEPTANCE_HTTP_SERVICE=y
CONFIG_APPHYPERVACCEPTANCE_HTTP_PORT=8080
CONFIG_APPHYPERVACCEPTANCE_HTTP_DURATION_MS=360000
CONFIG_APPHYPERVACCEPTANCE_HTTP_MAX_CONNS=64
CONFIG_HZ=100
```

## support/apps/hyperv-acceptance/storage-benchmark.defconfig
```kconfig
CONFIG_ARCH_X86_64=y
CONFIG_PLAT_HYPERV=y
CONFIG_UKPLAT_CPU_MAXCOUNT=1
CONFIG_UKPLAT_MEMREGION_MAX_COUNT=512
CONFIG_LIBUKPRINT_KLVL_INFO=y
CONFIG_LIBUKDEBUG_PRINTD=n
CONFIG_LIBUKALLOC_IFSTATS=y
CONFIG_APPHYPERVACCEPTANCE=y
CONFIG_APPHYPERVACCEPTANCE_STORAGE_BENCHMARK=y
CONFIG_APPHYPERVACCEPTANCE_STORAGE_BENCHMARK_RUN_ID="00112233445566778899aabbccddeeff"
CONFIG_APPHYPERVACCEPTANCE_STORAGE_BENCHMARK_DISK_ID="102132435465768798a9bacbdcedfe0f"
CONFIG_APPHYPERVACCEPTANCE_STORAGE_BENCHMARK_SECTORS=8388608
CONFIG_APPHYPERVACCEPTANCE_STORAGE_BENCHMARK_SECTOR_SIZE=512
CONFIG_APPHYPERVACCEPTANCE_STORAGE_BENCHMARK_IDENTITY_POLICY=2
CONFIG_APPHYPERVACCEPTANCE_STORAGE_BENCHMARK_LUN=7
CONFIG_APPHYPERVACCEPTANCE_STORAGE_BENCHMARK_MAX_SLOTS=32
CONFIG_APPHYPERVACCEPTANCE_STORAGE_BENCHMARK_MAX_TRANSFER_BYTES=131072
CONFIG_APPHYPERVACCEPTANCE_STORAGE_BENCHMARK_WARMUP_OPS=64
CONFIG_APPHYPERVACCEPTANCE_STORAGE_BENCHMARK_STEADY_OPS=256
CONFIG_APPHYPERVACCEPTANCE_STORAGE_BENCHMARK_TRIALS=3
CONFIG_LIBVMBUS=y
CONFIG_LIBUKBLKDEV=y
CONFIG_LIBSTORVSC=y
CONFIG_LIBSTORVSC_MAX_DEVICES=3
CONFIG_LIBSTORVSC_LUN_DISCOVERY=y
CONFIG_LIBSTORVSC_GUARDED_IO=y
CONFIG_LIBSTORVSC_MAX_LUNS=4
CONFIG_LIBSTORVSC_QUEUE_DEPTH=32
CONFIG_LIBSTORVSC_MAX_TRANSFER_PAGES=33
CONFIG_LIBSTORVSC_REQUEST_TIMEOUT_MS=5000
CONFIG_LIBUKSGLIST=y
CONFIG_LIBUKNETDEV=y
CONFIG_LIBNETVSC=y
```

## support/apps/hyperv-smp-workload/defconfig
```kconfig
CONFIG_ARCH_X86_64=y
CONFIG_PLAT_HYPERV=y
CONFIG_HAVE_SMP=y
CONFIG_UKPLAT_CPU_MAXCOUNT=2
CONFIG_UKPLAT_MEMREGION_MAX_COUNT=512
CONFIG_LIBUKPRINT_KLVL_INFO=y
CONFIG_LIBUKDEBUG_PRINTD=n
CONFIG_APPHYPERVSMPWORKLOAD=y
CONFIG_HYPERV_FIXED_SMP_WORKLOAD=y
```

## support/apps/wamr-aot/defconfig
```kconfig
CONFIG_ARCH_X86_64=y
CONFIG_PLAT_HYPERV=y
CONFIG_UKPLAT_CPU_MAXCOUNT=1
CONFIG_UKPLAT_MEMREGION_MAX_COUNT=512
CONFIG_LIBUKPRINT_KLVL_INFO=y
CONFIG_LIBUKDEBUG_PRINTD=n
CONFIG_APPWAMRAOT=y
CONFIG_LIBUKVMEM=y
CONFIG_LIBUKPAGING=y
CONFIG_LIBUKFALLOCBUDDY=y
```

## support/scripts/tests/fixtures/build-graph-app/defconfig
```kconfig
CONFIG_ARCH_X86_64=y
CONFIG_PLAT_KVM=y
CONFIG_KVM_BOOT_PROTO_MULTIBOOT=y
CONFIG_KVM_VMM_QEMU=y
CONFIG_HAVE_BOOTENTRY=y
CONFIG_LIBUKBOOT=y
CONFIG_LIBGRAPHFIXTURE=y
CONFIG_LIBUKSTORE=y
CONFIG_UK_NAME="graph-fixture"
```
